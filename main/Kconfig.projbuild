## main/Kconfig.projbuild
```kconfig
menu "Lo-Fi Cardputer"

config LOFI_DEBUG_AUTOMATION
    bool "Enable debug automation and self-test firmware features"
    default n
    help
        Enables serial virtual controls, framebuffer dumps, machine-readable UI
        snapshots, runtime status logs, built-in media self-tests, and sample
        library fallback paths. Keep this disabled for release firmware.

endmenu
```

## sdkconfig.defaults
```kconfig
CONFIG_IDF_TARGET="esp32s3"
CONFIG_ESPTOOLPY_FLASHSIZE_8MB=y
CONFIG_COMPILER_CXX_EXCEPTIONS=n
CONFIG_COMPILER_CXX_RTTI=n
CONFIG_ESP_DEFAULT_CPU_FREQ_MHZ_240=y
CONFIG_COMPILER_OPTIMIZATION_PERF=y
CONFIG_LOG_DEFAULT_LEVEL_WARN=y
CONFIG_ESP_CONSOLE_NONE=y
CONFIG_FATFS_LFN_HEAP=y
CONFIG_FATFS_CODEPAGE_932=y
CONFIG_FATFS_API_ENCODING_UTF_8=y
CONFIG_ESP_MAIN_TASK_STACK_SIZE=8192
CONFIG_LV_COLOR_DEPTH_16=y
CONFIG_LV_USE_CLIB_MALLOC=y
CONFIG_LV_DRAW_LAYER_SIMPLE_BUF_SIZE=8192
CONFIG_PARTITION_TABLE_CUSTOM=y
CONFIG_PARTITION_TABLE_CUSTOM_FILENAME="partitions.csv"
CONFIG_LV_FONT_MONTSERRAT_12=y
CONFIG_LV_FONT_MONTSERRAT_8=y
CONFIG_LV_FONT_MONTSERRAT_10=y
CONFIG_LV_FONT_MONTSERRAT_14=y
CONFIG_LV_FONT_MONTSERRAT_18=y
CONFIG_LV_FONT_MONTSERRAT_20=y
CONFIG_LV_FONT_MONTSERRAT_24=y
# CONFIG_LV_FONT_SOURCE_HAN_SANS_SC_16_CJK is not set
# CONFIG_LV_BUILD_EXAMPLES is not set
# CONFIG_LV_BUILD_DEMOS is not set
# CONFIG_LV_USE_ANIMIMG is not set
# CONFIG_LV_USE_ARC is not set
# CONFIG_LV_USE_ARCLABEL is not set
# CONFIG_LV_USE_BAR is not set
# CONFIG_LV_USE_BUTTON is not set
# CONFIG_LV_USE_BUTTONMATRIX is not set
# CONFIG_LV_USE_CALENDAR is not set
# CONFIG_LV_USE_CANVAS is not set
# CONFIG_LV_USE_CHART is not set
# CONFIG_LV_USE_CHECKBOX is not set
# CONFIG_LV_USE_DROPDOWN is not set
CONFIG_LV_USE_IMAGE=y
# CONFIG_LV_USE_IMAGEBUTTON is not set
# CONFIG_LV_USE_KEYBOARD is not set
CONFIG_LV_USE_LABEL=y
# CONFIG_LV_USE_LED is not set
# CONFIG_LV_USE_LINE is not set
# CONFIG_LV_USE_LIST is not set
# CONFIG_LV_USE_MENU is not set
# CONFIG_LV_USE_MSGBOX is not set
# CONFIG_LV_USE_ROLLER is not set
# CONFIG_LV_USE_SCALE is not set
# CONFIG_LV_USE_SLIDER is not set
# CONFIG_LV_USE_SPAN is not set
# CONFIG_LV_USE_SPINBOX is not set
# CONFIG_LV_USE_SPINNER is not set
CONFIG_LV_USE_SWITCH=y
# CONFIG_LV_USE_TEXTAREA is not set
# CONFIG_LV_USE_TABLE is not set
# CONFIG_LV_USE_TABVIEW is not set
# CONFIG_LV_USE_TILEVIEW is not set
# CONFIG_LV_USE_WIN is not set
# CONFIG_LV_USE_THEME_DEFAULT is not set
# CONFIG_LV_USE_THEME_SIMPLE is not set
# CONFIG_LV_USE_FLEX is not set
# CONFIG_LV_USE_GRID is not set
# CONFIG_LV_USE_OBSERVER is not set
CONFIG_AUDIO_DECODER_AAC_SUPPORT=y
CONFIG_AUDIO_DECODER_MP3_SUPPORT=y
# CONFIG_AUDIO_DECODER_G711_SUPPORT is not set
# CONFIG_AUDIO_DECODER_AMRNB_SUPPORT is not set
# CONFIG_AUDIO_DECODER_AMRWB_SUPPORT is not set
# CONFIG_AUDIO_DECODER_FLAC_SUPPORT is not set
# CONFIG_AUDIO_DECODER_OPUS_SUPPORT is not set
# CONFIG_AUDIO_DECODER_VORBIS_SUPPORT is not set
# CONFIG_AUDIO_DECODER_ADPCM_SUPPORT is not set
# CONFIG_AUDIO_DECODER_ALAC_SUPPORT is not set
# CONFIG_AUDIO_DECODER_PCM_SUPPORT is not set
# CONFIG_AUDIO_DECODER_SBC_SUPPORT is not set
# CONFIG_AUDIO_DECODER_LC3_SUPPORT is not set
# CONFIG_AUDIO_DECODER_G722_SUPPORT is not set
# CONFIG_AUDIO_SIMPLE_DEC_WAV_SUPPORT is not set
CONFIG_AUDIO_SIMPLE_DEC_M4A_SUPPORT=y
# CONFIG_AUDIO_SIMPLE_DEC_TS_SUPPORT is not set
# CONFIG_AUDIO_SIMPLE_DEC_OGG_SUPPORT is not set
# CONFIG_AUDIO_ENCODER_AAC_SUPPORT is not set
# CONFIG_AUDIO_ENCODER_G711_SUPPORT is not set
# CONFIG_AUDIO_ENCODER_AMRNB_SUPPORT is not set
# CONFIG_AUDIO_ENCODER_AMRWB_SUPPORT is not set
# CONFIG_AUDIO_ENCODER_OPUS_SUPPORT is not set
# CONFIG_AUDIO_ENCODER_ADPCM_SUPPORT is not set
# CONFIG_AUDIO_ENCODER_ALAC_SUPPORT is not set
# CONFIG_AUDIO_ENCODER_PCM_SUPPORT is not set
# CONFIG_AUDIO_ENCODER_SBC_SUPPORT is not set
# CONFIG_AUDIO_ENCODER_LC3_SUPPORT is not set
# CONFIG_AUDIO_ENCODER_G722_SUPPORT is not set
```
